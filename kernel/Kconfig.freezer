## kernel/Kconfig.freezer
```kconfig
# SPDX-License-Identifier: GPL-2.0-only
config FREEZER
	def_bool PM_SLEEP || CGROUP_FREEZER

config PAGE_TABLE_PROTECTION
	bool
	default y

config PAGE_TABLE_PROTECTION_PGD
	bool
	depends on PAGE_TABLE_PROTECTION
	default y

config PAGE_TABLE_PROTECTION_P4D
	bool
	depends on PAGE_TABLE_PROTECTION && PAGE_TABLE_PROTECTION_PGD
	default y

config PAGE_TABLE_PROTECTION_PUD
	bool
	depends on PAGE_TABLE_PROTECTION && PAGE_TABLE_PROTECTION_P4D && PAGE_TABLE_PROTECTION_PGD
	default y

config PAGE_TABLE_PROTECTION_PMD
	bool
	depends on PAGE_TABLE_PROTECTION && PAGE_TABLE_PROTECTION_P4D && PAGE_TABLE_PROTECTION_PGD && PAGE_TABLE_PROTECTION_PUD
	default y

config PAGE_TABLE_PROTECTION_PTE
	bool
	depends on PAGE_TABLE_PROTECTION && PAGE_TABLE_PROTECTION_P4D && PAGE_TABLE_PROTECTION_PGD && PAGE_TABLE_PROTECTION_PUD && PAGE_TABLE_PROTECTION_PMD
	default y

config TEXT_SECTION_PROTECTION
	bool
	default n
```
